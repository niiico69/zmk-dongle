## boards/shields/dongle/Kconfig.defconfig
```kconfig
if SHIELD_DONGLE

config ZMK_SPLIT
    default y

config ZMK_SPLIT_ROLE_CENTRAL
    default y

# Two halves by default. Unibody keyboards: override with
# -DCONFIG_ZMK_SPLIT_BLE_CENTRAL_PERIPHERALS=1 (and BT_MAX_* = 6).
config ZMK_SPLIT_BLE_CENTRAL_PERIPHERALS
    default 2

# peripherals + 5 host profiles
config BT_MAX_CONN
    default 7

config BT_MAX_PAIRED
    default 7

endif
```
